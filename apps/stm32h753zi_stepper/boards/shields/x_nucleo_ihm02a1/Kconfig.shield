## build/native_unit/Kconfig/Kconfig.modules
```kconfig
menu "acpica (/home/joeyw/zephyr-dev/modules/lib/acpica)"
osource "$(ZEPHYR_ACPICA_KCONFIG)"
config ZEPHYR_ACPICA_MODULE
	bool
	default y
endmenu
menu "cmsis (/home/joeyw/zephyr-dev/modules/hal/cmsis)"
osource "$(ZEPHYR_CMSIS_KCONFIG)"
config ZEPHYR_CMSIS_MODULE
	bool
	default y
endmenu
menu "cmsis-dsp (/home/joeyw/zephyr-dev/modules/lib/cmsis-dsp)"
osource "$(ZEPHYR_CMSIS_DSP_KCONFIG)"
config ZEPHYR_CMSIS_DSP_MODULE
	bool
	default y
endmenu
menu "cmsis-nn (/home/joeyw/zephyr-dev/modules/lib/cmsis-nn)"
osource "$(ZEPHYR_CMSIS_NN_KCONFIG)"
config ZEPHYR_CMSIS_NN_MODULE
	bool
	default y
endmenu
menu "cmsis_6 (/home/joeyw/zephyr-dev/modules/hal/cmsis_6)"
osource "$(ZEPHYR_CMSIS_6_KCONFIG)"
config ZEPHYR_CMSIS_6_MODULE
	bool
	default y
endmenu
menu "fatfs (/home/joeyw/zephyr-dev/modules/fs/fatfs)"
osource "$(ZEPHYR_FATFS_KCONFIG)"
config ZEPHYR_FATFS_MODULE
	bool
	default y
endmenu
config ZEPHYR_ADI_MODULE
	bool
	default y
menu "hal_afbr (/home/joeyw/zephyr-dev/modules/hal/afbr)"
osource "$(ZEPHYR_HAL_AFBR_KCONFIG)"
config ZEPHYR_HAL_AFBR_MODULE
	bool
	default y

config ZEPHYR_HAL_AFBR_MODULE_BLOBS
	bool
endmenu
menu "hal_ambiq (/home/joeyw/zephyr-dev/modules/hal/ambiq)"
osource "$(ZEPHYR_HAL_AMBIQ_KCONFIG)"
config ZEPHYR_HAL_AMBIQ_MODULE
	bool
	default y
endmenu
config ZEPHYR_ATMEL_MODULE
	bool
	default y
menu "hal_bouffalolab (/home/joeyw/zephyr-dev/modules/hal/bouffalolab)"
osource "$(ZEPHYR_HAL_BOUFFALOLAB_KCONFIG)"
config ZEPHYR_HAL_BOUFFALOLAB_MODULE
	bool
	default y
endmenu
menu "hal_espressif (/home/joeyw/zephyr-dev/modules/hal/espressif)"
osource "/home/joeyw/zephyr-dev/modules/hal/espressif/zephyr/Kconfig"
config ZEPHYR_HAL_ESPRESSIF_MODULE
	bool
	default y

config ZEPHYR_HAL_ESPRESSIF_MODULE_BLOBS
	bool
endmenu
menu "hal_ethos_u (/home/joeyw/zephyr-dev/modules/hal/ethos_u)"
osource "$(ZEPHYR_HAL_ETHOS_U_KCONFIG)"
config ZEPHYR_HAL_ETHOS_U_MODULE
	bool
	default y
endmenu
menu "hal_gigadevice (/home/joeyw/zephyr-dev/modules/hal/gigadevice)"
osource "$(ZEPHYR_HAL_GIGADEVICE_KCONFIG)"
config ZEPHYR_HAL_GIGADEVICE_MODULE
	bool
	default y
endmenu
menu "hal_infineon (/home/joeyw/zephyr-dev/modules/hal/infineon)"
osource "$(ZEPHYR_HAL_INFINEON_KCONFIG)"
config ZEPHYR_HAL_INFINEON_MODULE
	bool
	default y

config ZEPHYR_HAL_INFINEON_MODULE_BLOBS
	bool
endmenu
menu "hal_intel (/home/joeyw/zephyr-dev/modules/hal/intel)"
osource "/home/joeyw/zephyr-dev/modules/hal/intel/zephyr/Kconfig"
config ZEPHYR_HAL_INTEL_MODULE
	bool
	default y
endmenu
config ZEPHYR_MICROCHIP_MODULE
	bool
	default y
menu "hal_nordic (/home/joeyw/zephyr-dev/modules/hal/nordic)"
osource "$(ZEPHYR_HAL_NORDIC_KCONFIG)"
config ZEPHYR_HAL_NORDIC_MODULE
	bool
	default y

config ZEPHYR_HAL_NORDIC_MODULE_BLOBS
	bool
endmenu
config ZEPHYR_NUVOTON_MODULE
	bool
	default y
menu "hal_nxp (/home/joeyw/zephyr-dev/modules/hal/nxp)"
osource "$(ZEPHYR_HAL_NXP_KCONFIG)"
config ZEPHYR_HAL_NXP_MODULE
	bool
	default y

config ZEPHYR_HAL_NXP_MODULE_BLOBS
	bool
endmenu
config ZEPHYR_OPENISA_MODULE
	bool
	default y
config ZEPHYR_QUICKLOGIC_MODULE
	bool
	default y
config ZEPHYR_HAL_RENESAS_MODULE
	bool
	default y

config ZEPHYR_HAL_RENESAS_MODULE_BLOBS
	bool
menu "hal_rpi_pico (/home/joeyw/zephyr-dev/modules/hal/rpi_pico)"
osource "$(ZEPHYR_HAL_RPI_PICO_KCONFIG)"
config ZEPHYR_HAL_RPI_PICO_MODULE
	bool
	default y
endmenu
menu "hal_silabs (/home/joeyw/zephyr-dev/modules/hal/silabs)"
osource "$(ZEPHYR_HAL_SILABS_KCONFIG)"
config ZEPHYR_HAL_SILABS_MODULE
	bool
	default y

config ZEPHYR_HAL_SILABS_MODULE_BLOBS
	bool
endmenu
menu "hal_st (/home/joeyw/zephyr-dev/modules/hal/st)"
osource "$(ZEPHYR_HAL_ST_KCONFIG)"
config ZEPHYR_HAL_ST_MODULE
	bool
	default y
endmenu
config ZEPHYR_HAL_STM32_MODULE
	bool
	default y

config ZEPHYR_HAL_STM32_MODULE_BLOBS
	bool
menu "hal_tdk (/home/joeyw/zephyr-dev/modules/hal/tdk)"
osource "$(ZEPHYR_HAL_TDK_KCONFIG)"
config ZEPHYR_HAL_TDK_MODULE
	bool
	default y
endmenu
menu "hal_telink (/home/joeyw/zephyr-dev/modules/hal/telink)"
osource "/home/joeyw/zephyr-dev/modules/hal/telink/Kconfig"
config ZEPHYR_HAL_TELINK_MODULE
	bool
	default y
endmenu
config ZEPHYR_TI_MODULE
	bool
	default y
menu "hal_wch (/home/joeyw/zephyr-dev/modules/hal/wch)"
osource "$(ZEPHYR_HAL_WCH_KCONFIG)"
config ZEPHYR_HAL_WCH_MODULE
	bool
	default y
endmenu
config ZEPHYR_HAL_WURTHELEKTRONIK_MODULE
	bool
	default y
config ZEPHYR_XTENSA_MODULE
	bool
	default y
menu "hostap (/home/joeyw/zephyr-dev/modules/lib/hostap)"
osource "$(ZEPHYR_HOSTAP_KCONFIG)"
config ZEPHYR_HOSTAP_MODULE
	bool
	default y
endmenu
menu "liblc3 (/home/joeyw/zephyr-dev/modules/lib/liblc3)"
osource "$(ZEPHYR_LIBLC3_KCONFIG)"
config ZEPHYR_LIBLC3_MODULE
	bool
	default y
endmenu
config ZEPHYR_LIBMCTP_MODULE
	bool
	default y
config ZEPHYR_LIBMETAL_MODULE
	bool
	default y
menu "littlefs (/home/joeyw/zephyr-dev/modules/fs/littlefs)"
osource "$(ZEPHYR_LITTLEFS_KCONFIG)"
config ZEPHYR_LITTLEFS_MODULE
	bool
	default y
endmenu
menu "loramac-node (/home/joeyw/zephyr-dev/modules/lib/loramac-node)"
osource "$(ZEPHYR_LORAMAC_NODE_KCONFIG)"
config ZEPHYR_LORAMAC_NODE_MODULE
	bool
	default y
endmenu
menu "lvgl (/home/joeyw/zephyr-dev/modules/lib/gui/lvgl)"
osource "/home/joeyw/zephyr-dev/modules/lib/gui/lvgl/zephyr/Kconfig"
config ZEPHYR_LVGL_MODULE
	bool
	default y
endmenu
menu "mbedtls (/home/joeyw/zephyr-dev/modules/crypto/mbedtls)"
osource "$(ZEPHYR_MBEDTLS_KCONFIG)"
config ZEPHYR_MBEDTLS_MODULE
	bool
	default y
endmenu
config ZEPHYR_MCUBOOT_MODULE
	bool
	default y
config ZEPHYR_MIPI_SYS_T_MODULE
	bool
	default y
menu "nrf_wifi (/home/joeyw/zephyr-dev/modules/lib/nrf_wifi)"
osource "$(ZEPHYR_NRF_WIFI_KCONFIG)"
config ZEPHYR_NRF_WIFI_MODULE
	bool
	default y

config ZEPHYR_NRF_WIFI_MODULE_BLOBS
	bool
endmenu
config ZEPHYR_OPEN_AMP_MODULE
	bool
	default y
menu "openthread (/home/joeyw/zephyr-dev/modules/lib/openthread)"
osource "$(ZEPHYR_OPENTHREAD_KCONFIG)"
config ZEPHYR_OPENTHREAD_MODULE
	bool
	default y
endmenu
menu "percepio (/home/joeyw/zephyr-dev/modules/debug/percepio)"
osource "/home/joeyw/zephyr-dev/modules/debug/percepio/zephyr/Kconfig"
config ZEPHYR_PERCEPIO_MODULE
	bool
	default y
endmenu
menu "picolibc (/home/joeyw/zephyr-dev/modules/lib/picolibc)"
osource "/home/joeyw/zephyr-dev/modules/lib/picolibc/zephyr/Kconfig"
config ZEPHYR_PICOLIBC_MODULE
	bool
	default y
endmenu
menu "segger (/home/joeyw/zephyr-dev/modules/debug/segger)"
osource "$(ZEPHYR_SEGGER_KCONFIG)"
config ZEPHYR_SEGGER_MODULE
	bool
	default y
endmenu
config ZEPHYR_TINYCRYPT_MODULE
	bool
	default y
menu "trusted-firmware-a (/home/joeyw/zephyr-dev/modules/tee/tf-a/trusted-firmware-a)"
osource "$(ZEPHYR_TRUSTED_FIRMWARE_A_KCONFIG)"
config ZEPHYR_TRUSTED_FIRMWARE_A_MODULE
	bool
	default y
endmenu
menu "trusted-firmware-m (/home/joeyw/zephyr-dev/modules/tee/tf-m/trusted-firmware-m)"
osource "$(ZEPHYR_TRUSTED_FIRMWARE_M_KCONFIG)"
config ZEPHYR_TRUSTED_FIRMWARE_M_MODULE
	bool
	default y
endmenu
menu "uoscore-uedhoc (/home/joeyw/zephyr-dev/modules/lib/uoscore-uedhoc)"
osource "$(ZEPHYR_UOSCORE_UEDHOC_KCONFIG)"
config ZEPHYR_UOSCORE_UEDHOC_MODULE
	bool
	default y
endmenu
menu "zcbor (/home/joeyw/zephyr-dev/modules/lib/zcbor)"
osource "$(ZEPHYR_ZCBOR_KCONFIG)"
config ZEPHYR_ZCBOR_MODULE
	bool
	default y
endmenu
config ZEPHYR_NRF_HW_MODELS_MODULE
	bool
	default y
```

## build/native_unit/Kconfig/boards/Kconfig
```kconfig
# Load Zephyr board Kconfig descriptions.
osource "/home/joeyw/zephyr-dev/zephyr/zephyr/boards/native/native_sim/Kconfig"
```

## build/native_unit/Kconfig/boards/Kconfig.defconfig
```kconfig
# Load Zephyr board defconfig descriptions.
osource "/home/joeyw/zephyr-dev/zephyr/boards/native/native_sim/Kconfig.defconfig"
```

## build/native_unit/Kconfig/boards/Kconfig.native_sim
```kconfig
# Load board Kconfig descriptions.
osource "/home/joeyw/zephyr-dev/zephyr/zephyr/boards/native/native_sim/Kconfig.native_sim"
```

## build/native_unit/Kconfig/boards/Kconfig.sysbuild
```kconfig
# Load Sysbuild board Kconfig descriptions.
osource "/home/joeyw/zephyr-dev/zephyr/boards/native/native_sim/Kconfig.sysbuild"
```

## build/smoke_persist/Kconfig/boards/Kconfig
```kconfig
# Load Zephyr board Kconfig descriptions.
osource "/home/joeyw/zephyr-dev/zephyr/zephyr/boards/st/nucleo_h753zi/Kconfig"
```

## build/smoke_persist/Kconfig/boards/Kconfig.nucleo_h753zi
```kconfig
# Load board Kconfig descriptions.
osource "/home/joeyw/zephyr-dev/zephyr/zephyr/boards/st/nucleo_h753zi/Kconfig.nucleo_h753zi"
```

## twister-out.17/native_sim_native/host/stm32h753zi_stepper.unit/Kconfig/arch/Kconfig
```kconfig
# Load Zephyr Arch Kconfig descriptions.
osource "/home/joeyw/zephyr-dev/zephyr/arch/rx/Kconfig"
osource "/home/joeyw/zephyr-dev/zephyr/arch/x86/Kconfig"
osource "/home/joeyw/zephyr-dev/zephyr/arch/xtensa/Kconfig"
osource "/home/joeyw/zephyr-dev/zephyr/arch/sparc/Kconfig"
osource "/home/joeyw/zephyr-dev/zephyr/arch/riscv/Kconfig"
osource "/home/joeyw/zephyr-dev/zephyr/arch/posix/Kconfig"
osource "/home/joeyw/zephyr-dev/zephyr/arch/mips/Kconfig"
osource "/home/joeyw/zephyr-dev/zephyr/arch/arm64/Kconfig"
osource "/home/joeyw/zephyr-dev/zephyr/arch/arm/Kconfig"
osource "/home/joeyw/zephyr-dev/zephyr/arch/arc/Kconfig"
```

## twister-out.8/native_sim_native/host/stm32h753zi_stepper.unit/Kconfig/boards/Kconfig.native_sim
```kconfig
# Load board Kconfig descriptions.
osource "/home/joeyw/zephyr-dev/zephyr/boards/native/native_sim/Kconfig.native_sim"
```

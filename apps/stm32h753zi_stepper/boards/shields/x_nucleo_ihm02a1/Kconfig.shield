## apps/stm32h753zi_stepper/boards/shields/x_nucleo_ihm02a1/Kconfig.shield
```kconfig
config SHIELD_X_NUCLEO_IHM02A1
       bool "X-NUCLEO-IHM02A1 shield support"
       help
         Enable support for the X-NUCLEO-IHM02A1 stepper driver shield.

config L6470_MAX_SPEED_STEPS_PER_SEC
  int "L6470: maximum allowed speed (steps/s)"
  default 20000
       help
         Maximum allowed step speed in steps per second. This limit is used
         by the application to validate calls to l6470_run() and similar
         motion APIs. Adjust to match your motor/driver limits.

config L6470_MAX_CURRENT_MA
  int "L6470: maximum allowed current (mA)"
  default 3000
       help
         Maximum allowed motor current in milliamperes. Used for validation
         and to avoid commanding the driver beyond its safe thermal/current
         envelope. Verify against the X-NUCLEO-IHM02A1 and motor datasheets.

config L6470_MAX_STEPS_PER_COMMAND
  int "L6470: maximum allowed steps per MOVE command"
  default 8388607
       help
         Maximum steps allowed in a single MOVE command. L6470 supports up
         to 22-bit step counts; this default is a conservative large value.

config L6470_MAX_MICROSTEP
  int "L6470: maximum microstep division supported"
  default 128
       help
         Maximum microstep division the application will accept (e.g. 16
         for 1/16 microstepping). Used for validation when configuring
         microstep settings at runtime.
```

## apps/stm32h753zi_stepper/build/Kconfig/boards/Kconfig.defconfig
```kconfig
# Load Zephyr board defconfig descriptions.
osource "/home/joeyw/zephyr-dev/zephyr/zephyr/boards/st/nucleo_h753zi/Kconfig.defconfig"
```

## apps/stm32h753zi_stepper/tests/testcase.yaml
```yaml
tests:
  stm32h753zi_stepper.unit:
    platform_allow:
      - native_sim
    build_only: false
    tags:
      - unit
      - l6470
    harness: ztest
    integration_platforms:
      - native_sim
    extra_args:
      # Point Twister at the unit test application directory
      TESTDIR=apps/stm32h753zi_stepper/tests/unit
```

## apps/stm32h753zi_stepper/tests/unit/testcase.yaml
```yaml
tests:
  stm32h753zi_stepper.unit:
    platform_allow:
      - native_sim
    build_only: false
    tags:
      - unit
      - l6470
    harness: ztest
```

## build/Kconfig/arch/Kconfig
```kconfig
# Load Zephyr Arch Kconfig descriptions.
osource "/home/joeyw/zephyr-dev/zephyr/zephyr/arch/rx/Kconfig"
osource "/home/joeyw/zephyr-dev/zephyr/zephyr/arch/x86/Kconfig"
osource "/home/joeyw/zephyr-dev/zephyr/zephyr/arch/xtensa/Kconfig"
osource "/home/joeyw/zephyr-dev/zephyr/zephyr/arch/sparc/Kconfig"
osource "/home/joeyw/zephyr-dev/zephyr/zephyr/arch/riscv/Kconfig"
osource "/home/joeyw/zephyr-dev/zephyr/zephyr/arch/posix/Kconfig"
osource "/home/joeyw/zephyr-dev/zephyr/zephyr/arch/mips/Kconfig"
osource "/home/joeyw/zephyr-dev/zephyr/zephyr/arch/arm64/Kconfig"
osource "/home/joeyw/zephyr-dev/zephyr/zephyr/arch/arm/Kconfig"
osource "/home/joeyw/zephyr-dev/zephyr/zephyr/arch/arc/Kconfig"
```

## build/Kconfig/boards/Kconfig.sysbuild
```kconfig
# Load Sysbuild board Kconfig descriptions.
osource "/home/joeyw/zephyr-dev/zephyr/zephyr/boards/st/nucleo_h753zi/Kconfig.sysbuild"
```

## build/Kconfig/soc/Kconfig
```kconfig
# Load Zephyr SoC Kconfig descriptions.
osource "/home/joeyw/zephyr-dev/zephyr/zephyr/soc/xlnx/zynqmp/Kconfig"
osource "/home/joeyw/zephyr-dev/zephyr/zephyr/soc/xlnx/zynq7000/Kconfig"
osource "/home/joeyw/zephyr-dev/zephyr/zephyr/soc/xlnx/versalnet/Kconfig"
osource "/home/joeyw/zephyr-dev/zephyr/zephyr/soc/xlnx/versal2/Kconfig"
osource "/home/joeyw/zephyr-dev/zephyr/zephyr/soc/xen/Kconfig"
osource "/home/joeyw/zephyr-dev/zephyr/zephyr/soc/wch/ch32v/Kconfig"
osource "/home/joeyw/zephyr-dev/zephyr/zephyr/soc/ti/simplelink/Kconfig"
osource "/home/joeyw/zephyr-dev/zephyr/zephyr/soc/ti/mspm0/Kconfig"
osource "/home/joeyw/zephyr-dev/zephyr/zephyr/soc/ti/lm3s6965/Kconfig"
osource "/home/joeyw/zephyr-dev/zephyr/zephyr/soc/ti/k3/Kconfig"
osource "/home/joeyw/zephyr-dev/zephyr/zephyr/soc/telink/tlsr/Kconfig"
osource "/home/joeyw/zephyr-dev/zephyr/zephyr/soc/starfive/jh71xx/Kconfig"
osource "/home/joeyw/zephyr-dev/zephyr/zephyr/soc/st/stm32/Kconfig"
osource "/home/joeyw/zephyr-dev/zephyr/zephyr/soc/snps/qemu_arc/Kconfig"
osource "/home/joeyw/zephyr-dev/zephyr/zephyr/soc/snps/nsim/arc_v/Kconfig"
osource "/home/joeyw/zephyr-dev/zephyr/zephyr/soc/snps/nsim/arc_classic/Kconfig"
osource "/home/joeyw/zephyr-dev/zephyr/zephyr/soc/snps/hsdk4xd/Kconfig"
osource "/home/joeyw/zephyr-dev/zephyr/zephyr/soc/snps/hsdk/Kconfig"
osource "/home/joeyw/zephyr-dev/zephyr/zephyr/soc/snps/emsk/Kconfig"
osource "/home/joeyw/zephyr-dev/zephyr/zephyr/soc/snps/emsdp/Kconfig"
osource "/home/joeyw/zephyr-dev/zephyr/zephyr/soc/snps/arc_iot/Kconfig"
osource "/home/joeyw/zephyr-dev/zephyr/zephyr/soc/silabs/Kconfig"
osource "/home/joeyw/zephyr-dev/zephyr/zephyr/soc/sifive/sifive_freedom/Kconfig"
osource "/home/joeyw/zephyr-dev/zephyr/zephyr/soc/sensry/Kconfig"
osource "/home/joeyw/zephyr-dev/zephyr/zephyr/soc/rockchip/Kconfig"
osource "/home/joeyw/zephyr-dev/zephyr/zephyr/soc/renode/riscv_virtual/Kconfig"
osource "/home/joeyw/zephyr-dev/zephyr/zephyr/soc/renode/cortex_r8_virtual/Kconfig"
osource "/home/joeyw/zephyr-dev/zephyr/zephyr/soc/renesas/smartbond/Kconfig"
osource "/home/joeyw/zephyr-dev/zephyr/zephyr/soc/renesas/rz/Kconfig"
osource "/home/joeyw/zephyr-dev/zephyr/zephyr/soc/renesas/rx/Kconfig"
osource "/home/joeyw/zephyr-dev/zephyr/zephyr/soc/renesas/rcar/Kconfig"
osource "/home/joeyw/zephyr-dev/zephyr/zephyr/soc/renesas/ra/Kconfig"
osource "/home/joeyw/zephyr-dev/zephyr/zephyr/soc/realtek/ec/Kconfig"
osource "/home/joeyw/zephyr-dev/zephyr/zephyr/soc/raspberrypi/rpi_pico/Kconfig"
osource "/home/joeyw/zephyr-dev/zephyr/zephyr/soc/quicklogic/eos_s3/Kconfig"
osource "/home/joeyw/zephyr-dev/zephyr/zephyr/soc/qemu/virt_riscv/Kconfig"
osource "/home/joeyw/zephyr-dev/zephyr/zephyr/soc/qemu/malta/Kconfig"
osource "/home/joeyw/zephyr-dev/zephyr/zephyr/soc/openisa/rv32m1/Kconfig"
osource "/home/joeyw/zephyr-dev/zephyr/zephyr/soc/openhwgroup/cva6/Kconfig"
osource "/home/joeyw/zephyr-dev/zephyr/zephyr/soc/oct/osd32mp15x/Kconfig"
osource "/home/joeyw/zephyr-dev/zephyr/zephyr/soc/nxp/s32/Kconfig"
osource "/home/joeyw/zephyr-dev/zephyr/zephyr/soc/nxp/rw/Kconfig"
osource "/home/joeyw/zephyr-dev/zephyr/zephyr/soc/nxp/mcx/Kconfig"
osource "/home/joeyw/zephyr-dev/zephyr/zephyr/soc/nxp/lpc/Kconfig"
osource "/home/joeyw/zephyr-dev/zephyr/zephyr/soc/nxp/layerscape/Kconfig"
osource "/home/joeyw/zephyr-dev/zephyr/zephyr/soc/nxp/kinetis/Kconfig"
osource "/home/joeyw/zephyr-dev/zephyr/zephyr/soc/nxp/imxrt/Kconfig"
osource "/home/joeyw/zephyr-dev/zephyr/zephyr/soc/nxp/imx/Kconfig"
osource "/home/joeyw/zephyr-dev/zephyr/zephyr/soc/nuvoton/numicro/Kconfig"
osource "/home/joeyw/zephyr-dev/zephyr/zephyr/soc/nuvoton/numaker/Kconfig"
osource "/home/joeyw/zephyr-dev/zephyr/zephyr/soc/nuvoton/npcx/Kconfig"
osource "/home/joeyw/zephyr-dev/zephyr/zephyr/soc/nuvoton/npcm/Kconfig"
osource "/home/joeyw/zephyr-dev/zephyr/zephyr/soc/nordic/Kconfig"
osource "/home/joeyw/zephyr-dev/zephyr/zephyr/soc/neorv32/Kconfig"
osource "/home/joeyw/zephyr-dev/zephyr/zephyr/soc/native/inf_clock/Kconfig"
osource "/home/joeyw/zephyr-dev/zephyr/zephyr/soc/microchip/sam/Kconfig"
osource "/home/joeyw/zephyr-dev/zephyr/zephyr/soc/microchip/sam/sam_d5x_e5x/Kconfig"
osource "/home/joeyw/zephyr-dev/zephyr/zephyr/soc/microchip/miv/Kconfig"
osource "/home/joeyw/zephyr-dev/zephyr/zephyr/soc/microchip/mec/Kconfig"
osource "/home/joeyw/zephyr-dev/zephyr/zephyr/soc/mediatek/mt8xxx/Kconfig"
osource "/home/joeyw/zephyr-dev/zephyr/zephyr/soc/lowrisc/opentitan/Kconfig"
osource "/home/joeyw/zephyr-dev/zephyr/zephyr/soc/litex/litex_vexriscv/Kconfig"
osource "/home/joeyw/zephyr-dev/zephyr/zephyr/soc/ite/ec/Kconfig"
osource "/home/joeyw/zephyr-dev/zephyr/zephyr/soc/intel/raptor_lake/Kconfig"
osource "/home/joeyw/zephyr-dev/zephyr/zephyr/soc/intel/panther_lake/Kconfig"
osource "/home/joeyw/zephyr-dev/zephyr/zephyr/soc/intel/lakemont/Kconfig"
osource "/home/joeyw/zephyr-dev/zephyr/zephyr/soc/intel/intel_socfpga_std/Kconfig"
osource "/home/joeyw/zephyr-dev/zephyr/zephyr/soc/intel/intel_socfpga/Kconfig"
osource "/home/joeyw/zephyr-dev/zephyr/zephyr/soc/intel/intel_niosv/Kconfig"
osource "/home/joeyw/zephyr-dev/zephyr/zephyr/soc/intel/intel_ish/Kconfig"
osource "/home/joeyw/zephyr-dev/zephyr/zephyr/soc/intel/intel_adsp/Kconfig"
osource "/home/joeyw/zephyr-dev/zephyr/zephyr/soc/intel/elkhart_lake/Kconfig"
osource "/home/joeyw/zephyr-dev/zephyr/zephyr/soc/intel/atom/Kconfig"
osource "/home/joeyw/zephyr-dev/zephyr/zephyr/soc/intel/apollo_lake/Kconfig"
osource "/home/joeyw/zephyr-dev/zephyr/zephyr/soc/intel/alder_lake/Kconfig"
osource "/home/joeyw/zephyr-dev/zephyr/zephyr/soc/infineon/cat3/Kconfig"
osource "/home/joeyw/zephyr-dev/zephyr/zephyr/soc/infineon/cat1c/Kconfig"
osource "/home/joeyw/zephyr-dev/zephyr/zephyr/soc/infineon/cat1b/Kconfig"
osource "/home/joeyw/zephyr-dev/zephyr/zephyr/soc/infineon/cat1a/Kconfig"
osource "/home/joeyw/zephyr-dev/zephyr/zephyr/soc/gd/gd32/Kconfig"
osource "/home/joeyw/zephyr-dev/zephyr/zephyr/soc/gaisler/leon3/Kconfig"
osource "/home/joeyw/zephyr-dev/zephyr/zephyr/soc/gaisler/gr716a/Kconfig"
osource "/home/joeyw/zephyr-dev/zephyr/zephyr/soc/espressif/Kconfig"
osource "/home/joeyw/zephyr-dev/zephyr/zephyr/soc/ene/kb1200/Kconfig"
osource "/home/joeyw/zephyr-dev/zephyr/zephyr/soc/ene/kb106x/Kconfig"
osource "/home/joeyw/zephyr-dev/zephyr/zephyr/soc/efinix/sapphire/Kconfig"
osource "/home/joeyw/zephyr-dev/zephyr/zephyr/soc/cdns/xtensa_sample_controller/Kconfig"
osource "/home/joeyw/zephyr-dev/zephyr/zephyr/soc/cdns/sample_controller32/Kconfig"
osource "/home/joeyw/zephyr-dev/zephyr/zephyr/soc/cdns/dc233c/Kconfig"
osource "/home/joeyw/zephyr-dev/zephyr/zephyr/soc/brcm/bcmvk/Kconfig"
osource "/home/joeyw/zephyr-dev/zephyr/zephyr/soc/brcm/bcm2712/Kconfig"
osource "/home/joeyw/zephyr-dev/zephyr/zephyr/soc/brcm/bcm2711/Kconfig"
osource "/home/joeyw/zephyr-dev/zephyr/zephyr/soc/bflb/Kconfig"
osource "/home/joeyw/zephyr-dev/zephyr/zephyr/soc/atmel/sam0/Kconfig"
osource "/home/joeyw/zephyr-dev/zephyr/zephyr/soc/atmel/sam/Kconfig"
osource "/home/joeyw/zephyr-dev/zephyr/zephyr/soc/aspeed/Kconfig"
osource "/home/joeyw/zephyr-dev/zephyr/zephyr/soc/arm/Kconfig"
osource "/home/joeyw/zephyr-dev/zephyr/zephyr/soc/arm/beetle/Kconfig"
osource "/home/joeyw/zephyr-dev/zephyr/zephyr/soc/antmicro/myra/Kconfig"
osource "/home/joeyw/zephyr-dev/zephyr/zephyr/soc/andestech/Kconfig"
osource "/home/joeyw/zephyr-dev/zephyr/zephyr/soc/amd/acp_6_0/Kconfig"
osource "/home/joeyw/zephyr-dev/zephyr/zephyr/soc/ambiq/Kconfig"
osource "/home/joeyw/zephyr-dev/zephyr/zephyr/soc/aesc/Kconfig"
osource "/home/joeyw/zephyr-dev/zephyr/zephyr/soc/adi/max32/Kconfig"
```
